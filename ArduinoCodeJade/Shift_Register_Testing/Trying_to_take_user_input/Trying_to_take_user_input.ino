// inslude the SPI library:
#include <SPI.h>

// set pin 10 as the slave select for the digital pot:

const int slaveSelectPin = 10;
int bits = 0b10000000;
String temp = "";
int red = 0;
int green = 0;
int blue = 0;
int RGB = 0;

void setup() {
  
  Serial.begin(9600);

  // set the slaveSelectPin as an output:

  pinMode(slaveSelectPin, OUTPUT);

  // initialize SPI:

  SPI.begin();
  Serial.println("Red:");
  SPI.setBitOrder(LSBFIRST);
}

void loop() 
{
    
  colourSelect();


}
/*
void writebits(bits)
{
    digitalWrite(slaveSelectPin, LOW);
    SPI.transfer(bits);
    digitalWrite(slaveSelectPin, HIGH);
}
*/
void colourSelect()
{
  
  if (Serial.available() > 0) { 
    temp = Serial.read(); 
    Serial.print(temp);
    
    if (RGB == 2){
      blue = temp.toInt();
      RGB = 0;
      Serial.println(blue);
      Serial.println("Red:");
    }
    else if (RGB == 1){
      green = temp.toInt();
      RGB = 2;
      Serial.println(green);
      Serial.println("Blue:");
    }
    else if (RGB == 0){
      red = temp.toInt();
      RGB = 1;
      Serial.println(red);
      Serial.println("Green:");
    }


    delay(1000);
  }
}




