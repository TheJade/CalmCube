// inslude the SPI library:
#include <SPI.h>

// set pin 10 as the slave select for the digital pot:

const int slaveSelectPin = 10;
int bits = 0b00000000;  // sends in groups of 8 bits
//                   /       /       // sends frist 8 bits, then sends second 8 bits
                                    // if less then 8 bits you get sent
                                    
/*
int bits = 0b01000000111111110000; //first 4 outputs are high
//                   /       /      
int bits = 0b010000001111111100000000; // no leds on
int bits = 0b01000000111111110000000;  // just Q0 output high
int bits = 0b0100000010011111; // outputs are high: 0, 3, 4, 5, 6, 7

*/
int RGB = 0;
int speed = 0;
int colour_length = 100;
int start_loop = millis();

void setup() {
  
  Serial.begin(9600);

  // set the slaveSelectPin as an output:

  pinMode(slaveSelectPin, OUTPUT);

  // initialize SPI:

  SPI.begin();
  Serial.println("Start:");
  SPI.setBitOrder(LSBFIRST);
}



void loop() {
    colourchange();
}



void writebits()
{
    digitalWrite(slaveSelectPin, LOW);
    SPI.transfer(bits);
    digitalWrite(slaveSelectPin, HIGH);
}

void colourchange()
{
    unsigned int i = 0;
    start_loop = millis();
    while (((int)millis() - (start_loop + colour_length)) < 0)
    {
      if (RGB == 0) //red
      {
        bits = 0b10000000;
      }
      else if (RGB == 1) //orange
      {
        bits = 0b10000000;
        if (i % 2 == 0)
        {
          bits = bits + 0b01000000;
        }
      }
      else if (RGB == 2) //yellow
      {
        bits = 0b11000000;

      }
      else if (RGB == 3) //green
      {
        bits = 0b01000000;
      }
      else if (RGB == 4) //blue
      {
        bits = 0b00100000;
      }
      else if (RGB == 5) //dark purple
      {
        bits = 0b00000000;
        if (i % 2 == 0)
        {
          bits = bits + 0b00100000;
        }
        if (i % 3 == 0)
        {
          bits = bits + 0b10000000;
        }
      }
      else if (RGB == 6) //light purple
      {
        bits = 0b00000000;
        if ((i*3) % 5 == 0)
        {
          bits = bits + 0b10000000;
        }
        if ((i*4) % 5 == 0)
        {
          bits = bits + 0b00100000;
        }
      }
      writebits();
      i++;
    }
    delay(speed);
    RGB = RGB + 1;
    if (RGB == 7){
      RGB = 0;
    }
    i = 0;
    
}





